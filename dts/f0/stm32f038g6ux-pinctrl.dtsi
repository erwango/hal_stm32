
/*
 * WARNING: Autogenerated file using stm32_pinctrl_gen.py
 *
 * SPDX-License-Identifier: Apache-2.0
 */

#include <dt-bindings/pinctrl/stm32-pinctrl.h>
#include "../pinctrl_st_stm32.h"

/ {
	soc {
		pinctrl: pin-controller@48000000 {
			/* UART_CTS */
			DT_STM32_UART_CTS(a, 0, usart1, AF1);

			/* UART_RTS */
			DT_STM32_UART_RTS(a, 1, usart1, AF1);

			/* UART_TX */
			DT_STM32_UART_TX(a, 2, usart1, AF1);
			DT_STM32_UART_TX(a, 9, usart1, AF1);
			DT_STM32_UART_TX(a, 14, usart1, AF1);
			DT_STM32_UART_TX(b, 6, usart1, AF0);

			/* UART_RX */
			DT_STM32_UART_RX(a, 3, usart1, AF1);
			DT_STM32_UART_RX(a, 10, usart1, AF1);
			DT_STM32_UART_RX(a, 15, usart1, AF1);
			DT_STM32_UART_RX(b, 7, usart1, AF0);

		};
	};
};
