
/*
 * WARNING: Autogenerated file using stm32_pinctrl_gen.py
 *
 * SPDX-License-Identifier: Apache-2.0
 */

#include <dt-bindings/pinctrl/stm32-pinctrl.h>
#include "../pinctrl_st_stm32.h"

/ {
	soc {
		pinctrl: pin-controller@58020000 {
			/* UART_TX */
			DT_STM32_UART_TX(a, 0, uart4, AF8);
			DT_STM32_UART_TX(a, 2, usart2, AF7);
			DT_STM32_UART_TX(a, 9, uart1, AF3);
			DT_STM32_UART_TX(a, 9, usart1, AF7);
			DT_STM32_UART_TX(a, 12, uart4, AF6);
			DT_STM32_UART_TX(a, 15, uart7, AF11);
			DT_STM32_UART_TX(b, 4, uart7, AF11);
			DT_STM32_UART_TX(b, 6, uart1, AF8);
			DT_STM32_UART_TX(b, 6, uart5, AF14);
			DT_STM32_UART_TX(b, 6, usart1, AF7);
			DT_STM32_UART_TX(b, 9, uart4, AF8);
			DT_STM32_UART_TX(b, 10, usart3, AF7);
			DT_STM32_UART_TX(b, 13, uart5, AF14);
			DT_STM32_UART_TX(b, 14, usart1, AF4);
			DT_STM32_UART_TX(c, 6, usart6, AF7);
			DT_STM32_UART_TX(c, 10, uart4, AF8);
			DT_STM32_UART_TX(c, 10, usart3, AF7);
			DT_STM32_UART_TX(c, 12, uart5, AF8);

			/* UART_CTS */
			DT_STM32_UART_CTS(a, 0, usart2, AF7);
			DT_STM32_UART_CTS(a, 11, uart1, AF3);
			DT_STM32_UART_CTS(a, 11, usart1, AF7);
			DT_STM32_UART_CTS(b, 0, uart4, AF8);
			DT_STM32_UART_CTS(b, 13, usart3, AF7);
			DT_STM32_UART_CTS(b, 15, uart4, AF8);
			DT_STM32_UART_CTS(c, 9, uart5, AF8);

			/* UART_RX */
			DT_STM32_UART_RX(a, 1, uart4, AF8);
			DT_STM32_UART_RX(a, 3, usart2, AF7);
			DT_STM32_UART_RX(a, 8, uart7, AF11);
			DT_STM32_UART_RX(a, 10, uart1, AF3);
			DT_STM32_UART_RX(a, 10, usart1, AF7);
			DT_STM32_UART_RX(a, 11, uart4, AF6);
			DT_STM32_UART_RX(b, 3, uart7, AF11);
			DT_STM32_UART_RX(b, 5, uart5, AF14);
			DT_STM32_UART_RX(b, 7, uart1, AF8);
			DT_STM32_UART_RX(b, 7, usart1, AF7);
			DT_STM32_UART_RX(b, 8, uart4, AF8);
			DT_STM32_UART_RX(b, 12, uart5, AF14);
			DT_STM32_UART_RX(b, 15, usart1, AF4);
			DT_STM32_UART_RX(c, 7, usart6, AF7);
			DT_STM32_UART_RX(c, 11, uart4, AF8);
			DT_STM32_UART_RX(c, 11, usart3, AF7);
			DT_STM32_UART_RX(d, 2, uart5, AF8);

			/* UART_RTS */
			DT_STM32_UART_RTS(a, 1, usart2, AF7);
			DT_STM32_UART_RTS(a, 12, uart1, AF3);
			DT_STM32_UART_RTS(a, 12, usart1, AF7);
			DT_STM32_UART_RTS(a, 15, uart4, AF8);
			DT_STM32_UART_RTS(b, 14, uart4, AF8);
			DT_STM32_UART_RTS(b, 14, usart3, AF7);

		};
	};
};
