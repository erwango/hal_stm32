
/*
 * WARNING: Autogenerated file using stm32_pinctrl_gen.py
 *
 * SPDX-License-Identifier: Apache-2.0
 */

#include <dt-bindings/pinctrl/stm32-pinctrl.h>
#include "../pinctrl_st_stm32.h"

/ {
	soc {
		pinctrl: pin-controller@48000000 {
			/* UART_TX */
			DT_STM32_UART_TX(a, 2, uart1, AF8);
			DT_STM32_UART_TX(a, 9, usart1, AF7);
			DT_STM32_UART_TX(b, 5, uart1, AF8);
			DT_STM32_UART_TX(b, 6, usart1, AF7);
			DT_STM32_UART_TX(b, 11, uart1, AF8);
			DT_STM32_UART_TX(c, 1, uart1, AF8);

			/* UART_RX */
			DT_STM32_UART_RX(a, 3, uart1, AF8);
			DT_STM32_UART_RX(a, 10, usart1, AF7);
			DT_STM32_UART_RX(a, 12, uart1, AF8);
			DT_STM32_UART_RX(b, 7, usart1, AF7);
			DT_STM32_UART_RX(b, 10, uart1, AF8);
			DT_STM32_UART_RX(c, 0, uart1, AF8);

			/* UART_CTS */
			DT_STM32_UART_CTS(a, 6, uart1, AF8);
			DT_STM32_UART_CTS(a, 11, usart1, AF7);
			DT_STM32_UART_CTS(b, 4, usart1, AF7);
			DT_STM32_UART_CTS(b, 13, uart1, AF8);

			/* UART_RTS */
			DT_STM32_UART_RTS(a, 12, usart1, AF7);
			DT_STM32_UART_RTS(b, 1, uart1, AF8);
			DT_STM32_UART_RTS(b, 3, usart1, AF7);
			DT_STM32_UART_RTS(b, 12, uart1, AF8);

		};
	};
};
