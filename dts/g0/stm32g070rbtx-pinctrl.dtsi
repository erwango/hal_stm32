
/*
 * WARNING: Autogenerated file using stm32_pinctrl_gen.py
 *
 * SPDX-License-Identifier: Apache-2.0
 */

#include <dt-bindings/pinctrl/stm32-pinctrl.h>
#include "../pinctrl_st_stm32.h"

/ {
	soc {
		pinctrl: pin-controller@50000000 {
			/* UART_RX */
			DT_STM32_UART_RX(a, 1, usart4, AF4);
			DT_STM32_UART_RX(a, 3, usart2, AF1);
			DT_STM32_UART_RX(a, 10, usart1, AF1);
			DT_STM32_UART_RX(a, 10, usart1, AF1);
			DT_STM32_UART_RX(a, 15, usart2, AF1);
			DT_STM32_UART_RX(b, 0, usart3, AF4);
			DT_STM32_UART_RX(b, 7, usart1, AF0);
			DT_STM32_UART_RX(b, 9, usart3, AF4);
			DT_STM32_UART_RX(b, 11, usart3, AF4);
			DT_STM32_UART_RX(c, 5, usart1, AF1);
			DT_STM32_UART_RX(c, 5, usart3, AF0);
			DT_STM32_UART_RX(c, 11, usart3, AF0);
			DT_STM32_UART_RX(c, 11, usart4, AF1);
			DT_STM32_UART_RX(d, 6, usart2, AF0);
			DT_STM32_UART_RX(d, 9, usart3, AF0);

			/* UART_CTS */
			DT_STM32_UART_CTS(a, 0, usart2, AF1);
			DT_STM32_UART_CTS(a, 6, usart3, AF4);
			DT_STM32_UART_CTS(b, 4, usart1, AF4);
			DT_STM32_UART_CTS(b, 7, usart4, AF4);
			DT_STM32_UART_CTS(b, 13, usart3, AF4);
			DT_STM32_UART_CTS(d, 3, usart2, AF0);

			/* UART_TX */
			DT_STM32_UART_TX(a, 0, usart4, AF4);
			DT_STM32_UART_TX(a, 2, usart2, AF1);
			DT_STM32_UART_TX(a, 5, usart3, AF4);
			DT_STM32_UART_TX(a, 9, usart1, AF1);
			DT_STM32_UART_TX(a, 9, usart1, AF1);
			DT_STM32_UART_TX(b, 2, usart3, AF4);
			DT_STM32_UART_TX(b, 6, usart1, AF0);
			DT_STM32_UART_TX(b, 8, usart3, AF4);
			DT_STM32_UART_TX(b, 10, usart3, AF4);
			DT_STM32_UART_TX(c, 4, usart1, AF1);
			DT_STM32_UART_TX(c, 4, usart3, AF0);
			DT_STM32_UART_TX(c, 10, usart3, AF0);
			DT_STM32_UART_TX(c, 10, usart4, AF1);
			DT_STM32_UART_TX(d, 5, usart2, AF0);
			DT_STM32_UART_TX(d, 8, usart3, AF0);

			/* UART_RTS */
			DT_STM32_UART_RTS(a, 1, usart2, AF1);
			DT_STM32_UART_RTS(a, 15, usart3, AF5);
			DT_STM32_UART_RTS(a, 15, usart4, AF4);
			DT_STM32_UART_RTS(b, 1, usart3, AF4);
			DT_STM32_UART_RTS(b, 3, usart1, AF4);
			DT_STM32_UART_RTS(b, 14, usart3, AF4);
			DT_STM32_UART_RTS(d, 2, usart3, AF0);
			DT_STM32_UART_RTS(d, 4, usart2, AF0);

		};
	};
};
