
/*
 * WARNING: Autogenerated file using stm32_pinctrl_gen.py
 *
 * SPDX-License-Identifier: Apache-2.0
 */

#include <dt-bindings/pinctrl/stm32-pinctrl.h>
#include "../pinctrl_st_stm32.h"

/ {
	soc {
		pinctrl: pin-controller@50000000 {
			/* UART_CTS */
			DT_STM32_UART_CTS(a, 0, usart2, AF4);
			DT_STM32_UART_CTS(a, 6, uart1, AF4);
			DT_STM32_UART_CTS(a, 11, usart1, AF4);
			DT_STM32_UART_CTS(b, 4, usart1, AF5);
			DT_STM32_UART_CTS(b, 7, usart4, AF6);

			/* UART_TX */
			DT_STM32_UART_TX(a, 0, usart4, AF6);
			DT_STM32_UART_TX(a, 2, uart1, AF6);
			DT_STM32_UART_TX(a, 2, usart2, AF4);
			DT_STM32_UART_TX(a, 9, usart1, AF4);
			DT_STM32_UART_TX(a, 14, uart1, AF6);
			DT_STM32_UART_TX(a, 14, usart2, AF4);
			DT_STM32_UART_TX(b, 6, usart1, AF0);

			/* UART_RTS */
			DT_STM32_UART_RTS(a, 1, usart2, AF4);
			DT_STM32_UART_RTS(a, 12, usart1, AF4);
			DT_STM32_UART_RTS(b, 1, uart1, AF4);

			/* UART_RX */
			DT_STM32_UART_RX(a, 1, usart4, AF6);
			DT_STM32_UART_RX(a, 3, uart1, AF6);
			DT_STM32_UART_RX(a, 3, usart2, AF4);
			DT_STM32_UART_RX(a, 10, usart1, AF4);
			DT_STM32_UART_RX(a, 13, uart1, AF6);
			DT_STM32_UART_RX(b, 7, usart1, AF0);

		};
	};
};
