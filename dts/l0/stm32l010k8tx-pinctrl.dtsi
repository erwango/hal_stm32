
/*
 * WARNING: Autogenerated file using stm32_pinctrl_gen.py
 *
 * SPDX-License-Identifier: Apache-2.0
 */

#include <dt-bindings/pinctrl/stm32-pinctrl.h>
#include "../pinctrl_st_stm32.h"

/ {
	soc {
		pinctrl: pin-controller@50000000 {
			/* UART_CTS */
			DT_STM32_UART_CTS(a, 0, usart2, AF4);

			/* UART_RTS */
			DT_STM32_UART_RTS(a, 1, usart2, AF4);

			/* UART_TX */
			DT_STM32_UART_TX(a, 2, usart2, AF4);
			DT_STM32_UART_TX(a, 14, usart2, AF4);

			/* UART_RX */
			DT_STM32_UART_RX(a, 3, usart2, AF4);
			DT_STM32_UART_RX(a, 15, usart2, AF4);

		};
	};
};
