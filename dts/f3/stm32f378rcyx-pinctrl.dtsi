
/*
 * WARNING: Autogenerated file using stm32_pinctrl_gen.py
 *
 * SPDX-License-Identifier: Apache-2.0
 */

#include <dt-bindings/pinctrl/stm32-pinctrl.h>
#include "../pinctrl_st_stm32.h"

/ {
	soc {
		pinctrl: pin-controller@48000000 {
			/* UART_RX */
			DT_STM32_UART_RX(a, 3, usart2, AF7);
			DT_STM32_UART_RX(a, 10, usart1, AF7);
			DT_STM32_UART_RX(b, 4, usart2, AF7);
			DT_STM32_UART_RX(b, 7, usart1, AF7);
			DT_STM32_UART_RX(b, 9, usart3, AF7);
			DT_STM32_UART_RX(c, 5, usart1, AF7);
			DT_STM32_UART_RX(c, 11, usart3, AF7);

			/* UART_RTS */
			DT_STM32_UART_RTS(a, 1, usart2, AF7);
			DT_STM32_UART_RTS(a, 12, usart1, AF7);
			DT_STM32_UART_RTS(b, 14, usart3, AF7);
			DT_STM32_UART_RTS(f, 6, usart3, AF7);

			/* UART_TX */
			DT_STM32_UART_TX(a, 2, usart2, AF7);
			DT_STM32_UART_TX(a, 9, usart1, AF7);
			DT_STM32_UART_TX(b, 3, usart2, AF7);
			DT_STM32_UART_TX(b, 6, usart1, AF7);
			DT_STM32_UART_TX(b, 8, usart3, AF7);
			DT_STM32_UART_TX(c, 4, usart1, AF7);
			DT_STM32_UART_TX(c, 10, usart3, AF7);
			DT_STM32_UART_TX(d, 8, usart3, AF7);

			/* UART_CTS */
			DT_STM32_UART_CTS(a, 0, usart2, AF7);
			DT_STM32_UART_CTS(a, 11, usart1, AF7);
			DT_STM32_UART_CTS(a, 13, usart3, AF7);

		};
	};
};
