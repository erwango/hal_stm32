
/*
 * WARNING: Autogenerated file using stm32_pinctrl_gen.py
 *
 * SPDX-License-Identifier: Apache-2.0
 */

#include <dt-bindings/pinctrl/stm32-pinctrl.h>
#include "../pinctrl_st_stm32.h"

/ {
	soc {
		pinctrl: pin-controller@40020000 {
			/* UART_TX */
			DT_STM32_UART_TX(a, 2, usart2, AF7);
			DT_STM32_UART_TX(a, 9, usart1, AF7);
			DT_STM32_UART_TX(a, 11, usart6, AF8);
			DT_STM32_UART_TX(a, 15, usart1, AF7);
			DT_STM32_UART_TX(b, 6, usart1, AF7);
			DT_STM32_UART_TX(b, 10, usart3, AF7);
			DT_STM32_UART_TX(c, 6, usart6, AF8);
			DT_STM32_UART_TX(c, 10, usart3, AF7);
			DT_STM32_UART_TX(d, 5, usart2, AF7);

			/* UART_RX */
			DT_STM32_UART_RX(a, 3, usart2, AF7);
			DT_STM32_UART_RX(a, 10, usart1, AF7);
			DT_STM32_UART_RX(a, 12, usart6, AF8);
			DT_STM32_UART_RX(b, 3, usart1, AF7);
			DT_STM32_UART_RX(b, 7, usart1, AF7);
			DT_STM32_UART_RX(b, 11, usart3, AF7);
			DT_STM32_UART_RX(c, 5, usart3, AF7);
			DT_STM32_UART_RX(c, 7, usart6, AF8);
			DT_STM32_UART_RX(c, 11, usart3, AF7);
			DT_STM32_UART_RX(d, 6, usart2, AF7);
			DT_STM32_UART_RX(d, 9, usart3, AF7);

			/* UART_RTS */
			DT_STM32_UART_RTS(a, 1, usart2, AF7);
			DT_STM32_UART_RTS(a, 12, usart1, AF7);
			DT_STM32_UART_RTS(b, 14, usart3, AF7);
			DT_STM32_UART_RTS(d, 4, usart2, AF7);
			DT_STM32_UART_RTS(d, 12, usart3, AF7);

			/* UART_CTS */
			DT_STM32_UART_CTS(a, 0, usart2, AF7);
			DT_STM32_UART_CTS(a, 11, usart1, AF7);
			DT_STM32_UART_CTS(b, 13, usart3, AF8);
			DT_STM32_UART_CTS(d, 3, usart2, AF7);
			DT_STM32_UART_CTS(d, 11, usart3, AF7);

		};
	};
};
